## techpack/audio/asoc/codecs/cs35l41/Kconfig
```kconfig
config SND_SOC_CS35L41
	tristate "Cirrus Logic CS35L41 codec"
	select MFD_SPK_ID
	help
	  Say Y or M here if you want to add support for the Cirrus Logic
	  CS35L41 codec.
```
